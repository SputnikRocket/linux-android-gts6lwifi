## Documentation/devicetree/bindings/display/panel/samsung,amsa05rb06.yaml
```yaml
# SPDX-License-Identifier: GPL-2.0-only OR BSD-2-Clause
%YAML 1.2
---
$id: http://devicetree.org/schemas/display/panel/samsung,amsa05rb06.yaml#
$schema: http://devicetree.org/meta-schemas/core.yaml#

title: Samsung AMSA05RB06 dual-DSI AMOLED panel

maintainers:
  - SputnikRocket <108942763+SputnikRocket@users.noreply.github.com>

description:
  The Samsung AMSA05RB06 is a 10.5" 2560x1600 command mode AMOLED panel with
  an Anapass ANA38401 display driver IC, driven over two DSI links that each
  carry one 1280x1600 half. It is used in the Samsung Galaxy Tab S6.

allOf:
  - $ref: panel-common-dual.yaml#

properties:
  compatible:
    const: samsung,amsa05rb06

  reg:
    maxItems: 1

  vddio-supply:
    description: 1.8V I/O supply

  vdd-supply:
    description: Panel power supply

  reset-gpios:
    maxItems: 1
    description: Reset line, active low

  tcon-rdy-gpios:
    maxItems: 1
    description:
      TCON_RDY output of the display driver IC, high once it is ready after
      a reset.

required:
  - compatible
  - reg
  - vddio-supply
  - vdd-supply
  - reset-gpios
  - ports

unevaluatedProperties: false

examples:
  - |
    #include <dt-bindings/gpio/gpio.h>

    dsi {
        #address-cells = <1>;
        #size-cells = <0>;

        panel@0 {
            compatible = "samsung,amsa05rb06";
            reg = <0>;

            vddio-supply = <&vreg_l14a_1p8>;
            vdd-supply = <&panel_vdd>;
            reset-gpios = <&tlmm 59 GPIO_ACTIVE_LOW>;
            tcon-rdy-gpios = <&tlmm 140 GPIO_ACTIVE_HIGH>;

            ports {
                #address-cells = <1>;
                #size-cells = <0>;

                port@0 {
                    reg = <0>;
                    panel_in_0: endpoint {
                        remote-endpoint = <&mdss_dsi0_out>;
                    };
                };

                port@1 {
                    reg = <1>;
                    panel_in_1: endpoint {
                        remote-endpoint = <&mdss_dsi1_out>;
                    };
                };
            };
        };
    };

...
```

## Documentation/devicetree/bindings/extcon/siliconmitus,sm5705-muic.yaml
```yaml
# SPDX-License-Identifier: (GPL-2.0-only OR BSD-2-Clause)
%YAML 1.2
---
$id: http://devicetree.org/schemas/extcon/siliconmitus,sm5705-muic.yaml#
$schema: http://devicetree.org/meta-schemas/core.yaml#

title: Silicon Mitus SM5705 MUIC (Micro-USB Interface Controller)

maintainers:
  - SputnikRocket <108942763+SputnikRocket@users.noreply.github.com>

description:
  The MUIC block of the Silicon Mitus SM5705 power management IC detects
  accessories on the USB connector and switches its D+/D- lines to the USB
  PHY, a UART or an audio path. It has its own I2C address, separate from
  the charger and fuel gauge blocks of the SM5705.

properties:
  compatible:
    const: siliconmitus,sm5705-muic

  reg:
    maxItems: 1
    description: I2C address of the MUIC block, usually 0x25.

  interrupts:
    maxItems: 1

required:
  - compatible
  - reg

additionalProperties: false

examples:
  - |
    #include <dt-bindings/interrupt-controller/irq.h>
    i2c {
        #address-cells = <1>;
        #size-cells = <0>;

        extcon@25 {
            compatible = "siliconmitus,sm5705-muic";
            reg = <0x25>;
            interrupt-parent = <&tlmm>;
            interrupts = <122 IRQ_TYPE_LEVEL_LOW>;
        };
    };
```

## Documentation/devicetree/bindings/input/touchscreen/st,fts1ba90a.yaml
```yaml
# SPDX-License-Identifier: (GPL-2.0-only OR BSD-2-Clause)
%YAML 1.2
---
$id: http://devicetree.org/schemas/input/touchscreen/st,fts1ba90a.yaml#
$schema: http://devicetree.org/meta-schemas/core.yaml#

title: STMicroelectronics FTS1BA90A touchscreen controller

maintainers:
  - SputnikRocket <108942763+SputnikRocket@users.noreply.github.com>

description:
  Capacitive touchscreen controller with Samsung's firmware, as used in the
  Samsung Galaxy Tab S6. It is not compatible with the controllers handled
  by st,stmfts.

allOf:
  - $ref: touchscreen.yaml#

properties:
  compatible:
    const: st,fts1ba90a

  reg:
    maxItems: 1

  interrupts:
    maxItems: 1

  avdd-supply:
    description: Analog supply (3.3V)

  vdd-supply:
    description: Digital supply (1.8V)

unevaluatedProperties: false

required:
  - compatible
  - reg
  - interrupts
  - avdd-supply
  - vdd-supply
  - touchscreen-size-x
  - touchscreen-size-y

examples:
  - |
    #include <dt-bindings/interrupt-controller/irq.h>
    i2c {
        #address-cells = <1>;
        #size-cells = <0>;

        touchscreen@49 {
            compatible = "st,fts1ba90a";
            reg = <0x49>;
            interrupt-parent = <&tlmm>;
            interrupts = <87 IRQ_TYPE_LEVEL_LOW>;
            avdd-supply = <&vreg_l17a_3p3>;
            vdd-supply = <&vreg_l14a_1p8>;
            touchscreen-size-x = <1600>;
            touchscreen-size-y = <2560>;
        };
    };
```
